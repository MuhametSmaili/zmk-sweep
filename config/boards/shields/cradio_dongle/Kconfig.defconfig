## config/boards/shields/cradio_dongle/Kconfig.defconfig
```kconfig
if SHIELD_CRADIO_DONGLE

config ZMK_KEYBOARD_NAME
    default "Smaili"

config ZMK_SPLIT_ROLE_CENTRAL
    default y

config ZMK_USB
    default y

endif

if SHIELD_CRADIO_LEFT || SHIELD_CRADIO_RIGHT || SHIELD_CRADIO_DONGLE

config ZMK_SPLIT
    default y

config ZMK_BLE
    default y

endif
```
